## Documentation/devicetree/bindings/motion/adi,tmc5240.yaml
```yaml
# SPDX-License-Identifier: (GPL-2.0 OR BSD-2-Clause)
%YAML 1.2
---
$id: http://devicetree.org/schemas/motion/adi,tmc5240.yaml#
$schema: http://devicetree.org/meta-schemas/core.yaml#

title: Analog Devices TMC5240 Stepper Motor controller

maintainers:
  - David Jander <david@protonic>

description:
  Stepper motor controller with motion engine and SPI interface.

properties:
  compatible:
    enum:
      - adi,tmc5240

  reg:
    maxItems: 1

  interrupts:
    maxItems: 1

  clocks:
    maxItems: 1

  vs-supply:
    description: Motor supply voltage.

  vcc-io-supply:
    description: Digital IO supply voltage.

required:
  - compatible
  - reg
  - interrupts
  - clocks
  - vs-supply
  - vcc-io-supply

allOf:
  - $ref: /schemas/spi/spi-peripheral-props.yaml#
  - $ref: /schemas/motion/common.yaml#

unevaluatedProperties: false

examples:
  - |
    #include <dt-bindings/interrupt-controller/arm-gic.h>
    spi {
        #address-cells = <1>;
        #size-cells = <0>;

        motor@0 {
            compatible = "adi,tmc5240";
            reg = <0>;
            interrupts-extended = <&gpiok 7 IRQ_TYPE_LEVEL_LOW>;
            clocks = <&clock_tmc5240>;
            vs-supply = <&vcc_24v>;
            vcc-io-supply = <&vdd3v3>;
            spi-max-frequency = <1000000>;
        };
    };
```

## Documentation/devicetree/bindings/motion/motion-simple-pwm.yaml
```yaml
# SPDX-License-Identifier: (GPL-2.0 OR BSD-2-Clause)
%YAML 1.2
---
$id: http://devicetree.org/schemas/motion/motion-simple-pwm.yaml#
$schema: http://devicetree.org/meta-schemas/core.yaml#

title: Simple PWM based motor controller

maintainers:
  - David Jander <david@protonic>

description:
  Simple motor control device based on 1 or 2 PWM outputs

properties:
  compatible:
    enum:
      - motion-simple-pwm

  pwms:
    items:
      - description: First PWM channel, can be used for left or right direction.
      - description: Optional second PWM channel for the opposite direction.
    minItems: 1

  pwm-names:
    items:
      - const: left
      - const: right
    minItems: 1

  pwm-inverted:
    $ref: /schemas/types.yaml#/definitions/flag
    description:
      If present, this flag indicates that the PWM signal should be inverted.
      The duty-cycle will be scaled from 100% down to 0% instead 0% to 100%.

required:
  - compatible
  - pwms
  - pwm-names

allOf:
  - $ref: /schemas/motion/common.yaml#

unevaluatedProperties: false

examples:
  - |
    // This example shows how to use the TI DRV8873 or similar motor controllers
    // with this driver
    motor0 {
      compatible = "motion-simple-pwm";
      pwms = <&hpdcm0_pwm 0 50000 0>,
             <&hpdcm0_pwm 1 50000 0>;
      pwm-names = "left", "right";
      pwm-inverted;
      speed-conv-mul = <3600>;
      speed-conv-div = <100000>;
      acceleration-conv-mul = <3600>;
      acceleration-conv-div = <100000>;
    };
```
